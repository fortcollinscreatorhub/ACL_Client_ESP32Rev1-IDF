## main/Kconfig.projbuild
```kconfig
menu "ACL_Client Configuration"

    config WIFI_SSID
        string "WiFi SSID"
        default "myssid"
        help
            SSID (network name) for the example to connect to.

    config WIFI_PASSWORD
        string "WiFi Password"
        default "mypassword"
        help
            WiFi password (WPA or WPA2) for the example to use.

            Can be left blank if the network has no security set.

    config ACL
        string "ACL"
        default "door"
        help
            ACL name to query. Choices are: small-laser-cutter, medium-laser-cutter
            big-laser-cutter, sawstop, door, cncrouter

endmenu
```
